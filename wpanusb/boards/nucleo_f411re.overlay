#include <dt-bindings/gpio/gpio.h>

&spi1 {
	status = "okay";

	cc2520: cc2520@0 {
		compatible = "ti,cc2520";
		label = "CC2520";
		reg = <0>;
		spi-max-frequency = <10000000>;
		vreg-en-gpios = <&gpioa 1 (GPIO_PULL_UP|GPIO_ACTIVE_LOW)>;
		reset-gpios = <&gpioa 2 (GPIO_PULL_UP|GPIO_ACTIVE_LOW)>;
		fifo-gpios = <&gpioa 3 (GPIO_PULL_UP|GPIO_ACTIVE_LOW)>;
		cca-gpios = <&gpioa 4 (GPIO_PULL_UP|GPIO_ACTIVE_LOW)>;
		sfd-gpios = <&gpioa 5 (GPIO_PULL_UP|GPIO_ACTIVE_LOW)>;
		fifop-gpios = <&gpioa 6 (GPIO_PULL_UP|GPIO_ACTIVE_LOW)>;
	};
};
