## stm32f401cc_boardtest/boards/arm/stm32f401cc_minimal/Kconfig.board
```kconfig
config BOARD_STM32F401CC_MINIMAL
	bool "STM32F401CC Minimal Development Board"
	depends on SOC_STM32F401XC
```

## stm32f401cc_boardtest/boards/arm/stm32f401cc_minimal/Kconfig.defconfig
```kconfig
if BOARD_STM32F401CC_MINIMAL

config BOARD
	default "stm32f401cc_miniamal"

if WATCHDOG

config WWDG_STM32
	default y

config IWDG_STM32
	default y

endif # WATCHDOG

endif # BOARD_STM32F401CC_MINIMAL
```

## stm32f401cc_boardtest/boards/arm/stm32f401cc_minimal/stm32f401cc_minimal_defconfig
```kconfig
CONFIG_SOC_SERIES_STM32F4X=y
CONFIG_SOC_STM32F401XC=y

CONFIG_SYS_CLOCK_HW_CYCLES_PER_SEC=84000000

CONFIG_ARM_MPU=y
CONFIG_SERIAL=y

CONFIG_CONSOLE=y
CONFIG_UART_CONSOLE=y

CONFIG_PINMUX=y
CONFIG_GPIO=y

CONFIG_CLOCK_CONTROL=y

CONFIG_CLOCK_STM32_HSE_CLOCK=8000000
CONFIG_CLOCK_STM32_SYSCLK_SRC_PLL=y
CONFIG_CLOCK_STM32_PLL_SRC_HSE=y
CONFIG_CLOCK_STM32_HSE_BYPASS=n
CONFIG_CLOCK_STM32_PLL_M_DIVISOR=8
CONFIG_CLOCK_STM32_PLL_N_MULTIPLIER=336
CONFIG_CLOCK_STM32_PLL_P_DIVISOR=4
CONFIG_CLOCK_STM32_PLL_Q_DIVISOR=7
CONFIG_CLOCK_STM32_AHB_PRESCALER=1
CONFIG_CLOCK_STM32_APB1_PRESCALER=2
CONFIG_CLOCK_STM32_APB2_PRESCALER=1
```
